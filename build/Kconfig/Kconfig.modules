## build/Kconfig/Kconfig.modules
```kconfig
osource "/home/skobec/Programs/ncs/nrf/Kconfig.nrf"

osource "/home/skobec/Programs/ncs/bootloader/mcuboot/zephyr/Kconfig"

osource "/home/skobec/Programs/ncs/nrfxlib/Kconfig.nrfxlib"
```

## build/Kconfig/Kconfig.soc.arch
```kconfig
osource "/home/skobec/Programs/ncs/zephyr/soc/$(ARCH)/Kconfig"
osource "/home/skobec/Programs/ncs/zephyr/soc/$(ARCH)/*/Kconfig"
```

## drivers/flash/Kconfig
```kconfig
# Copyright (c) 2021 Nordic Semiconductor ASA
# SPDX-License-Identifier: Apache-2.0

menuconfig SPI_FLASH_EN25
	bool "EN25 family flash driver"
	select FLASH_HAS_DRIVER_ENABLED
	depends on SPI
	depends on FLASH
	help
	  This driver can handle several instances of EN25 family chips that
	  are enabled by specifying devicetree nodes with the "compatible"
	  property set to "atmel,at45" and other required properties like
	  JEDEC ID, chip capacity, block and page size etc. configured
	  accordingly.

	  The driver is only capable of using "power of 2" binary page sizes
	  in those chips and at initialization configures them to work in
	  that mode (unless it is already done).

if SPI_FLASH_EN25

config SPI_FLASH_EN25_INIT_PRIORITY
	int "Driver initialization priority"
	default 80
	help
	  Device driver initialization priority.
	  SPI driver needs to be initialized before this one.

endif # SPI_FLASH_EN25
```

## tests/flash_read_write/testcase.yaml
```yaml
tests:
  tests.flash.flash_read_write:
    # Set of platforms that this test case can be run on.
    platform_allow: nrf52840dk_nrf52840
    harness: ztest
    # Only build the test, do not run it
    build_only: True
```

## tests/integration/testcase.yaml
```yaml
tests:
  # section.subsection
  testing.ztest:
    platform_allow: nrf52840dk_nrf52840
    tags: testing
    default: true
```
